/*
 * ============================================================================
 * ШАБЛОН ДЛЯ ESP32-S3 N16R8 (16MB Flash + 8MB PSRAM)
 * ============================================================================
 * 
 * ХАРАКТЕРИСТИКИ ПЛАТЫ:
 * - Flash память: 16 MB (место для прошивки и файлов)
 * - PSRAM: 8 MB (внешняя оперативная память)
 * - Встроенная RAM: ~512 KB
 * 
 * ПОДКЛЮЧЕНИЕ OLED ДИСПЛЕЯ SSD1306 (128x64):
 * - VCC  → 3V3  (питание 3.3 вольта)
 * - GND  → GND  (земля)
 * - SCL  → GPIO9 (линия тактового сигнала I2C)
 * - SDA  → GPIO8 (линия данных I2C)
 * 
 * Адрес дисплея на шине I2C: 0x3C (стандартный для 128x64)
 * 
 * ============================================================================
 */

// ============================================================================
// БИБЛИОТЕКИ
// ============================================================================

// Wire.h - библиотека для работы с шиной I2C
// Позволяет общаться с устройствами: дисплеи, датчики, RTC, и т.д.
#include <Wire.h>

// Adafruit_GFX.h - базовая графическая библиотека
// Предоставляет примитивы: линии, прямоугольники, круги, текст, шрифты
#include <Adafruit_GFX.h>

// Adafruit_SSD1306.h - библиотека для OLED дисплеев SSD1306
// Работает поверх Adafruit_GFX, добавляет специфичные команды для дисплея
#include <Adafruit_SSD1306.h>

// ============================================================================
// КОНСТАНТЫ И НАСТРОЙКИ ДИСПЛЕЯ
// ============================================================================

// Размеры дисплея в пикселях
#define SCREEN_WIDTH 128   // Ширина: 128 пикселей
#define SCREEN_HEIGHT 64   // Высота: 64 пикселя

// Пины I2C для подключения дисплея
// GPIO8  - SDA (линия данных) - данные передаются по этому проводу
// GPIO9  - SCL (линия тактов)  - синхронизирует передачу данных
#define I2C_SDA 8
#define I2C_SCL 9

// Создаем объект display для управления OLED экраном
// Параметры:
//   SCREEN_WIDTH, SCREEN_HEIGHT - размеры дисплея
//   &Wire                        - использовать основную шину I2C
//   -1                           - пин сброса не используется (-1)
Adafruit_SSD1306 display(SCREEN_WIDTH, SCREEN_HEIGHT, &Wire, -1);

// ============================================================================
// ФУНКЦИЯ setup() - ВЫПОЛНЯЕТСЯ ОДИН РАЗ ПРИ СТАРТЕ
// ============================================================================
// Здесь инициализируются все компоненты: Serial, I2C, дисплей, датчики
// ============================================================================

void setup() {
    // ------------------------------------------------------------------------
    // 1. ЗАДЕРЖКА ПРИ СТАРТЕ (важно для USB/UART!)
    // ------------------------------------------------------------------------
    // Задержка 3 секунды дает время:
    // - Открыть Serial Monitor до начала вывода данных
    // - Стабилизировать питание после включения
    // - Инициализировать USB соединение (для плат с USB CDC)
    delay(3000);
    
    // ------------------------------------------------------------------------
    // 2. ИНИЦИАЛИЗАЦИЯ ПОСЛЕДОВАТЕЛЬНОГО ПОРТА (Serial Monitor)
    // ------------------------------------------------------------------------
    // Serial - это объект для обмена данными с компьютером через USB/UART
    // 115200 - скорость передачи данных (бод)
    // Должна совпадать со скоростью в настройках Serial Monitor
    Serial.begin(115200);
    
    // ------------------------------------------------------------------------
    // 3. ВЫВОД ЗАГОЛОВКА В SERIAL MONITOR
    // ------------------------------------------------------------------------
    // println() - печатает строку и переводит курсор на новую строку
    // printf()  - печатает форматированную строку (как в C)
    Serial.println();
    Serial.println("=========================================");
    Serial.println("ESP32-S3 N16R8 Template");
    Serial.println("=========================================");
    Serial.println();
    
    // ------------------------------------------------------------------------
    // 4. ИНФОРМАЦИЯ О СИСТЕМЕ (CHIP, FLASH, PSRAM, HEAP)
    // ------------------------------------------------------------------------
    Serial.println("--- SYSTEM INFORMATION ---");
    
    // ESP.getChipModel() - возвращает строку с моделью чипа
    // Выведет: "ESP32-S3"
    Serial.printf("Chip: %s\n", ESP.getChipModel());
    
    // ESP.getFlashChipSize() - возвращает размер Flash в байтах
    // Делим на 1024*1024 (1 048 576) чтобы получить мегабайты
    // Выведет: "Flash Size: 16 MB"
    Serial.printf("Flash Size: %d MB\n", ESP.getFlashChipSize() / (1024 * 1024));
    
    // psramFound() - проверяет, обнаружена ли внешняя PSRAM память
    // Возвращает true (есть) или false (нет)
    if(psramFound()) {
        // ESP.getPsramSize() - размер PSRAM в байтах
        Serial.printf("PSRAM Size: %d MB\n", ESP.getPsramSize() / (1024 * 1024));
        
        // ESP.getFreePsram() - свободное место в PSRAM в байтах
        // Делим на 1024 чтобы получить килобайты
        Serial.printf("Free PSRAM: %d KB\n", ESP.getFreePsram() / 1024);
    } else {
        Serial.println("PSRAM: NOT FOUND");
    }
    
    // ESP.getFreeHeap() - свободная внутренняя RAM в байтах
    // Heap - это динамическая память для переменных, массивов, объектов
    Serial.printf("Free Heap: %d KB\n", ESP.getFreeHeap() / 1024);
    Serial.println();
    
    // ------------------------------------------------------------------------
    // 5. ИНИЦИАЛИЗАЦИЯ I2C ШИНЫ
    // ------------------------------------------------------------------------
    // I2C (Inter-Integrated Circuit) - последовательная шина для подключения
    // периферийных устройств (дисплеи, датчики, часы реального времени)
    // Плюсы I2C: нужно всего 2 провода (SDA и SCL) для множества устройств
    Serial.println("--- I2C INITIALIZATION ---");
    
    // Wire.begin() - запускает I2C шину на указанных пинах
    // I2C_SDA (8) - пин для данных
    // I2C_SCL (9) - пин для тактового сигнала
    Wire.begin(I2C_SDA, I2C_SCL);
    Serial.printf("SDA: GPIO%d, SCL: GPIO%d\n", I2C_SDA, I2C_SCL);
    
    // ------------------------------------------------------------------------
    // 6. СКАНИРОВАНИЕ I2C ШИНЫ
    // ------------------------------------------------------------------------
    // Это полезная диагностика: проверяет, какие устройства подключены к I2C
    // Каждое I2C устройство имеет уникальный адрес (от 1 до 127)
    Serial.println("Scanning I2C bus...");
    
    // Перебираем все возможные адреса от 1 до 126 (0 - зарезервирован)
    for (uint8_t addr = 1; addr < 127; addr++) {
        // Начинаем передачу на адрес addr
        Wire.beginTransmission(addr);
        
        // endTransmission() завершает передачу и возвращает:
        // 0 - устройство ответило (успех)
        // 1 - ошибка (данные слишком длинные)
        // 2 - адрес не найден (NACK)
        // 3 - ошибка данных
        // 4 - другие ошибки
        if (Wire.endTransmission() == 0) {
            // Устройство найдено! Выводим его адрес
            Serial.printf("Found device at 0x%02X", addr);
            
            // 0x3C - стандартный адрес OLED дисплеев 128x64
            if (addr == 0x3C) {
                Serial.println(" (SSD1306 OLED)");
            } else {
                Serial.println();
            }
        }
    }
    Serial.println();
    
    // ------------------------------------------------------------------------
    // 7. ИНИЦИАЛИЗАЦИЯ OLED ДИСПЛЕЯ
    // ------------------------------------------------------------------------
    // display.begin() - запускает дисплей
    // Параметр 1: SSD1306_SWITCHCAPVCC - встроенный генератор напряжения
    // Параметр 2: 0x3C - I2C адрес дисплея (стандартный)
    if(!display.begin(SSD1306_SWITCHCAPVCC, 0x3C)) {
        // Если дисплей не инициализировался (не отвечает по I2C)
        Serial.println("ERROR: OLED not found!");
        // while(true) - бесконечный цикл, программа останавливается
        // Дальнейший код не выполняется
        while(true);
    }
    
    // Если дошли сюда - дисплей работает!
    Serial.println("OLED initialized SUCCESSFULLY!");
    Serial.println();
    
    // ------------------------------------------------------------------------
    // 8. ВЫВОД ИНФОРМАЦИИ НА ДИСПЛЕЙ
    // ------------------------------------------------------------------------
    // Очищаем буфер дисплея (стираем всё, что было)
    display.clearDisplay();
    
    // Устанавливаем размер текста:
    // 1 - маленький шрифт (6x8 пикселей)
    display.setTextSize(1);
    
    // Устанавливаем цвет текста:
    // SSD1306_WHITE - белый (включенные пиксели)
    // SSD1306_BLACK - черный (выключенные пиксели)
    display.setTextColor(SSD1306_WHITE);
    
    // Устанавливаем позицию курсора (X, Y) в пикселях
    // (0,0) - верхний левый угол экрана
    display.setCursor(0, 0);
    
    // println() - печатает строку на дисплее и переводит курсор вниз
    display.println("ESP32-S3 N16R8");
    display.println("==============");
    
    // printf() - форматированный вывод на дисплей
    // %d - место для целого числа
    display.printf("Flash: %dMB", ESP.getFlashChipSize() / (1024*1024));
    display.println();
    
    if(psramFound()) {
        display.printf("PSRAM: %dMB", ESP.getPsramSize() / (1024*1024));
    } else {
        display.println("PSRAM: NO");
    }
    
    display.println();
    display.println("=== READY ===");
    
    // display.display() - ОТПРАВЛЯЕТ БУФЕР НА ДИСПЛЕЙ!
    // Без этого вызова на экране ничего не появится
    display.display();
    
    // ------------------------------------------------------------------------
    // 9. ЗАВЕРШЕНИЕ setup()
    // ------------------------------------------------------------------------
    Serial.println("=== SETUP COMPLETE ===");
    Serial.println("=========================================");
}

// ============================================================================
// ФУНКЦИЯ loop() - ВЫПОЛНЯЕТСЯ БЕСКОНЕЧНО ПОСЛЕ setup()
// ============================================================================
// Здесь размещается основная логика программы
// ============================================================================

void loop() {
    // static переменные сохраняют значение между вызовами loop()
    // Обычные переменные создаются заново при каждом вызове loop()
    static unsigned long lastPrint = 0;  // Время последнего вывода (в миллисекундах)
    static int counter = 0;              // Счетчик секунд
    
    // millis() - возвращает количество миллисекунд с момента запуска
    // Тип unsigned long - число от 0 до 4 294 967 295 (~49 дней)
    
    // Проверяем, прошло ли 5 секунд с последнего вывода
    // lastPrint хранит время последнего вывода
    if (millis() - lastPrint >= 5000) {
        
        // Увеличиваем счетчик на 5 секунд
        counter += 5;
        
        // Выводим информацию в Serial Monitor
        // %ds   - целое число секунд
        // %d    - целое число
        // \n    - перевод строки
        Serial.printf("[%ds] Heap: %d KB | PSRAM: %d KB\n", 
                      counter,                                    // прошло секунд
                      ESP.getFreeHeap() / 1024,                  // свободная RAM
                      psramFound() ? ESP.getFreePsram() / 1024 : 0); // свободная PSRAM
        
        // Сохраняем время последнего вывода
        lastPrint = millis();
    }
    
    // Небольшая задержка, чтобы не нагружать процессор
    // 100 миллисекунд - достаточно для стабильной работы
    delay(100);
}

// ============================================================================
// ПОЛЕЗНЫЕ ФУНКЦИИ (раскомментировать при необходимости)
// ============================================================================

/*
// Функция для вывода всей информации о памяти
void printMemoryInfo() {
    Serial.println("\n=== MEMORY INFO ===");
    Serial.printf("Free Heap (RAM): %d KB\n", ESP.getFreeHeap() / 1024);
    Serial.printf("Min Free Heap: %d KB\n", ESP.getMinFreeHeap() / 1024);
    Serial.printf("Max Alloc Heap: %d KB\n", ESP.getMaxAllocHeap() / 1024);
    
    if(psramFound()) {
        Serial.printf("Free PSRAM: %d KB\n", ESP.getFreePsram() / 1024);
    }
    
    Serial.printf("Sketch size: %d KB\n", ESP.getSketchSize() / 1024);
    Serial.printf("Free sketch space: %d KB\n", ESP.getFreeSketchSpace() / 1024);
    Serial.println("==================\n");
}

// Функция для сканирования I2C устройств
void scanI2C() {
    Serial.println("Scanning I2C...");
    int count = 0;
    for(uint8_t addr = 1; addr < 127; addr++) {
        Wire.beginTransmission(addr);
        if(Wire.endTransmission() == 0) {
            Serial.printf("Found at 0x%02X\n", addr);
            count++;
        }
    }
    Serial.printf("Found %d device(s)\n", count);
}

// Функция для очистки экрана и вывода текста
void displayText(const char* text, int x, int y, int size = 1) {
    display.setTextSize(size);
    display.setCursor(x, y);
    display.println(text);
    display.display();
}

// Функция для рисования "живого" индикатора работы
void showHeartbeat() {
    static int beat = 0;
    // Рисуем маленький квадрат в углу экрана
    if(beat % 2 == 0) {
        display.fillRect(120, 0, 8, 8, SSD1306_WHITE);
    } else {
        display.fillRect(120, 0, 8, 8, SSD1306_BLACK);
    }
    display.display();
    beat++;
}
*/

// ============================================================================
// КОНФИГУРАЦИЯ platformio.ini 
// ============================================================================
/*
[env:freenove_esp32_s3_wroom]
platform = espressif32
board = freenove_esp32_s3_wroom
framework = arduino

; НАСТРОЙКИ ПАМЯТИ ДЛЯ N16R8 (16MB Flash + 8MB PSRAM)
board_build.flash_size = 16MB
board_build.psram = enabled
board_build.psram_mode = octal
board_build.arduino.memory_type = qio_opi
board_build.f_cpu = 240000000L

; НАСТРОЙКИ ПОРТА
monitor_speed = 115200
upload_speed = 921600
monitor_filters = esp32_exception_decoder

; ФЛАГИ КОМПИЛЯЦИИ
build_flags = 
    -DCORE_DEBUG_LEVEL=0
    -DBOARD_HAS_PSRAM=1

; БИБЛИОТЕКИ ДЛЯ OLED ДИСПЛЕЯ
lib_deps = 
    adafruit/Adafruit GFX Library@^1.12.6
    adafruit/Adafruit SSD1306@^2.5.16
*/