/*
 * ============================================================================
 * ШАБЛОН: ESP32-S3 + OLED SSD1306 + КНОПКА (с антидребезгом)
 * ============================================================================
 * 
 * НАЗНАЧЕНИЕ:
 *   Демонстрация подключения кнопки к ESP32-S3 с обработкой антидребезга
 *   и отображением состояния на OLED дисплее.
 * 
 * ПОДКЛЮЧЕНИЕ КОМПОНЕНТОВ:
 * 
 *   OLED DISPLAY SSD1306 (128x64):
 *   - VCC  → 3V3   (питание 3.3V)
 *   - GND  → GND   (общая земля)
 *   - SCL  → GPIO9 (линия тактового сигнала I2C)
 *   - SDA  → GPIO8 (линия данных I2C)
 *   - Адрес на шине: 0x3C (стандартный для 128x64)
 * 
 *   КНОПКА (тактовая, без фиксации):
 *   - Один контакт → GPIO21 (сигнальный пин)
 *   - Второй контакт → GND (земля)
 *   
 * 
 * ПРИНЦИП РАБОТЫ:
 *   1. Внутренняя подтяжка (INPUT_PULLUP) подтягивает пин к 3.3V
 *   2. При нажатии кнопки пин замыкается на GND → уровень LOW
 *   3. Программа отслеживает изменение уровня с задержкой (антидребезг)
 *   4. При каждом нажатии увеличивается счетчик и обновляется дисплей
 * 
 * ============================================================================
 */

// ============================================================================
// ПОДКЛЮЧЕНИЕ БИБЛИОТЕК
// ============================================================================

// Wire.h - библиотека для работы с шиной I2C
// Обеспечивает связь с устройствами по двум проводам (SDA и SCL)
#include <Wire.h>

// Adafruit_GFX.h - базовая графическая библиотека
// Предоставляет функции для рисования: текст, линии, прямоугольники, круги
#include <Adafruit_GFX.h>

// Adafruit_SSD1306.h - драйвер для OLED дисплеев SSD1306
// Работает поверх Adafruit_GFX, добавляет специфичные команды
#include <Adafruit_SSD1306.h>

// ============================================================================
// КОНСТАНТЫ ДЛЯ OLED ДИСПЛЕЯ
// ============================================================================

// Размеры дисплея в пикселях (стандарт для SSD1306 128x64)
#define SCREEN_WIDTH 128   // Ширина: 128 пикселей по горизонтали
#define SCREEN_HEIGHT 64   // Высота: 64 пикселя по вертикали

// Пины I2C для подключения дисплея
// I2C_SDA - пин для данных (Serial DAta)
// I2C_SCL - пин для тактового сигнала (Serial CLock)
#define I2C_SDA 8          // GPIO8 назначен для данных
#define I2C_SCL 9          // GPIO9 назначен для тактирования

// I2C адрес дисплея
// 0x3C - стандартный адрес для OLED 128x64
// 0x3D - альтернативный адрес (встречается реже)
#define OLED_ADDR 0x3C

// Создаем объект display для управления OLED экраном
// Параметры конструктора:
//   SCREEN_WIDTH, SCREEN_HEIGHT - размеры дисплея
//   &Wire                        - указатель на объект I2C шины
//   -1                           - пин сброса не используется (указан -1)
Adafruit_SSD1306 display(SCREEN_WIDTH, SCREEN_HEIGHT, &Wire, -1);

// ============================================================================
// КОНСТАНТЫ ДЛЯ КНОПКИ
// ============================================================================

// Номер пина GPIO, к которому подключена кнопка
#define BUTTON_PIN 21

// Задержка антидребезга в миллисекундах
// При механическом нажатии кнопка "дребезжит" (многократно замыкается/размыкается)
// Задержка 50 мс позволяет дождаться стабильного состояния
#define DEBOUNCE_DELAY 50

// ============================================================================
// ГЛОБАЛЬНЫЕ ПЕРЕМЕННЫЕ
// ============================================================================

// buttonState - ТЕКУЩЕЕ стабильное состояние кнопки после антидребезга
//   LOW  - кнопка нажата (замкнута на GND)
//   HIGH - кнопка отпущена (подтянута к 3.3V через внутренний резистор)
bool buttonState = false;

// lastButtonState - ПРЕДЫДУЩЕЕ состояние кнопки
//   Используется для обнаружения изменения состояния
bool lastButtonState = false;

// pressCount - Счетчик количества нажатий
//   Увеличивается каждый раз, когда кнопка переходит из HIGH в LOW
//   Тип int - может хранить до 32 767 нажатий
int pressCount = 0;

// lastDebounceTime - Время последнего изменения состояния кнопки (в миллисекундах)
//   Используется для отсчета задержки антидребезга
//   Тип unsigned long - хранит миллисекунды с момента запуска
unsigned long lastDebounceTime = 0;

// ============================================================================
// ФУНКЦИЯ updateDisplay()
// ОТВЕЧАЕТ ЗА ВЫВОД ВСЕЙ ИНФОРМАЦИИ НА OLED ДИСПЛЕЙ
// ============================================================================
void updateDisplay() {
    // display.clearDisplay() - очищает ВНУТРЕННИЙ БУФЕР дисплея
    // Важно: на самом дисплее ничего не меняется до вызова display.display()
    // Буфер - это массив 128x64 бит = 1024 байта
    display.clearDisplay();
    
    // display.setTextSize(1) - устанавливает размер шрифта
    // 1 = нормальный (6x8 пикселей на символ)
    // 2 = двойной (12x16)
    // 3 = тройной (18x24) и т.д.
    display.setTextSize(1);
    
    // display.setTextColor(SSD1306_WHITE) - устанавливает цвет текста
    // SSD1306_WHITE - включенные пиксели (светятся)
    // SSD1306_BLACK - выключенные пиксели (фон)
    display.setTextColor(SSD1306_WHITE);
    
    // display.setCursor(x, y) - устанавливает позицию курсора
    // x - координата по горизонтали (0 = левый край)
    // y - координата по вертикали (0 = верхний край)
    display.setCursor(0, 0);
    
    // ========== ВЫВОД ЗАГОЛОВКА ==========
    // println() - печатает строку и переводит курсор на следующую строку
    display.println("BUTTON STATUS");
    display.println("=============");
    display.println();  // Пустая строка для отступа
    
    // ========== ВЫВОД СОСТОЯНИЯ КНОПКИ ==========
    display.print("State: ");        // print() - печатает без перевода строки
    if (buttonState == LOW) {        // LOW = кнопка нажата
        display.println("PRESSED");   // println() - с переводом строки
    } else {                          // HIGH = кнопка отпущена
        display.println("RELEASED");
    }
    
    // ========== ВЫВОД СЧЕТЧИКА НАЖАТИЙ ==========
    display.print("Clicks: ");
    display.println(pressCount);      // println() для числа (автоматическое преобразование)
    
    // ========== ВЫВОД НОМЕРА ПИНА ==========
    display.print("GPIO: ");
    display.println(BUTTON_PIN);
    
    // ========== ВЫВОД ВРЕМЕНИ РАБОТЫ ==========
    display.print("Uptime: ");
    // millis() - возвращает количество миллисекунд с момента запуска
    // / 1000 - преобразуем в секунды
    display.print(millis() / 1000);
    display.println("s");
    
    // display.display() - ОТПРАВЛЯЕТ БУФЕР НА ФИЗИЧЕСКИЙ ДИСПЛЕЙ
    // Без этого вызова на экране ничего не появится!
    display.display();
}

// ============================================================================
// ФУНКЦИЯ setup()
// ВЫПОЛНЯЕТСЯ ОДИН РАЗ ПРИ ЗАПУСКЕ ИЛИ СБРОСЕ МИКРОКОНТРОЛЛЕРА
// ============================================================================
void setup() {
    // ========== 1. ЗАДЕРЖКА ПРИ ЗАПУСКЕ ==========
    // Задержка 2 секунды дает время:
    //   - Стабилизировать питание после включения
    //   - Успеть открыть Serial Monitor до начала вывода
    //   - Инициализировать USB соединение
    delay(2000);
    
    // ========== 2. ИНИЦИАЛИЗАЦИЯ SERIAL ==========
    // Serial - объект для обмена данными с компьютером через USB/UART
    // 115200 - скорость передачи данных в бодах (бит/сек)
    Serial.begin(115200);
    
    // Задержка после инициализации Serial
    // Дает время на установку соединения с компьютером
    delay(500);
    
    // ========== 3. ВЫВОД ЗАГОЛОВКА В SERIAL MONITOR ==========
    // println() - печатает строку и переводит курсор на новую строку
    Serial.println();
    Serial.println("=========================================");
    Serial.println("ESP32-S3 + OLED + BUTTON TEST");
    Serial.println("=========================================");
    
    // ========== 4. ИНИЦИАЛИЗАЦИЯ КНОПКИ ==========
    // pinMode() - настраивает режим работы пина
    //   Первый параметр: номер пина (BUTTON_PIN = 21)
    //   Второй параметр: режим (INPUT_PULLUP)
    // 
    // INPUT_PULLUP - режим входа с внутренней подтяжкой к 3.3V
    //   - Пин по умолчанию имеет уровень HIGH (логическая 1)
    //   - При подключении кнопки между пином и GND:
    //     * Кнопка отпущена: пин HIGH (1)
    //     * Кнопка нажата:   пин LOW  (0)
    //   - Преимущество: не нужен внешний резистор
    pinMode(BUTTON_PIN, INPUT_PULLUP);
    
    Serial.printf("Button pin: GPIO%d (INPUT_PULLUP)\n", BUTTON_PIN);
    Serial.println("Active level: LOW (pressed when connected to GND)");
    
    // ========== 5. ИНИЦИАЛИЗАЦИЯ I2C ШИНЫ ==========
    // Wire.begin() - запускает I2C шину
    //   Первый параметр: пин SDA (данные)
    //   Второй параметр: пин SCL (тактирование)
    Wire.begin(I2C_SDA, I2C_SCL);
    
    Serial.printf("I2C: SDA=GPIO%d, SCL=GPIO%d\n", I2C_SDA, I2C_SCL);
    
    // ========== 6. ИНИЦИАЛИЗАЦИЯ OLED ДИСПЛЕЯ ==========
    Serial.println("Initializing OLED...");
    
    // display.begin() - запускает OLED дисплей
    //   Первый параметр: SSD1306_SWITCHCAPVCC - встроенный генератор напряжения
    //   Второй параметр: OLED_ADDR (0x3C) - I2C адрес дисплея
    // 
    // Функция возвращает:
    //   true  - инициализация успешна
    //   false - дисплей не отвечает (ошибка подключения)
    if(!display.begin(SSD1306_SWITCHCAPVCC, OLED_ADDR)) {
        // Если дисплей не найден - выводим ошибку в Serial
        Serial.println("ERROR: OLED not found!");
        Serial.println("Check wiring: SDA->GPIO8, SCL->GPIO9, VCC->3.3V, GND->GND");
        
        // while(true) - бесконечный цикл
        // Программа останавливается здесь и не идет дальше
        while(true);
    }
    
    Serial.println("OLED initialized successfully!");
    
    // display.clearDisplay() - очищаем буфер дисплея
    display.clearDisplay();
    
    // display.display() - отправляем очищенный буфер на физический дисплей
    display.display();
    
    // Дополнительная задержка перед первым выводом данных
    delay(500);
    
    // ========== 7. ПЕРВЫЙ ВЫВОД НА ДИСПЛЕЙ ==========
    // Вызываем функцию обновления дисплея
    // На этот момент buttonState = false (HIGH), pressCount = 0
    updateDisplay();
    
    // ========== 8. ЗАВЕРШЕНИЕ setup() ==========
    Serial.println("Ready!");
    Serial.println("=========================================\n");
}

// ============================================================================
// ФУНКЦИЯ loop()
// ВЫПОЛНЯЕТСЯ БЕСКОНЕЧНО ПОСЛЕ ЗАВЕРШЕНИЯ setup()
// ============================================================================
void loop() {
    // ========== 1. ЧТЕНИЕ ТЕКУЩЕГО СОСТОЯНИЯ ПИНА ==========
    // digitalRead() - читает текущий уровень на пине
    //   Возвращает HIGH (1) или LOW (0)
    //   При нажатой кнопке (замкнута на GND) → LOW
    //   При отпущенной кнопке (подтяжка к 3.3V) → HIGH
    bool currentReading = digitalRead(BUTTON_PIN);
    
    // ========== 2. ОБНАРУЖЕНИЕ ИЗМЕНЕНИЯ СОСТОЯНИЯ ==========
    // Если текущее состояние отличается от предыдущего...
    // Это первый признак того, что кнопка была нажата или отпущена
    if (currentReading != lastButtonState) {
        // Запоминаем время этого изменения (в миллисекундах)
        lastDebounceTime = millis();
    }
    
    // ========== 3. АНТИДРЕБЕЗГ (СТАБИЛИЗАЦИЯ СИГНАЛА) ==========
    // Проверяем, прошло ли достаточно времени с момента последнего изменения
    // millis() - текущее время в миллисекундах
    // lastDebounceTime - время последнего изменения
    // DEBOUNCE_DELAY (50) - задержка для стабилизации
    if ((millis() - lastDebounceTime) > DEBOUNCE_DELAY) {
        
        // ========== 4. ПРОВЕРКА РЕАЛЬНОГО ИЗМЕНЕНИЯ ==========
        // Если после задержки состояние все еще отличается от стабильного...
        if (currentReading != buttonState) {
            
            // Обновляем стабильное состояние кнопки
            buttonState = currentReading;
            
            // ========== 5. РЕАКЦИЯ НА НАЖАТИЕ ==========
            // Если кнопка нажата (уровень LOW)
            if (buttonState == LOW) {
                // Увеличиваем счетчик нажатий
                pressCount++;
                
                // Выводим сообщение в Serial Monitor
                // printf() - форматированный вывод
                // %d - placeholder для целого числа
                Serial.printf("[BUTTON] PRESSED! Total clicks: %d\n", pressCount);
                
            } else {
                // Если кнопка отпущена
                Serial.println("[BUTTON] RELEASED");
            }
            
            // ========== 6. ОБНОВЛЕНИЕ ДИСПЛЕЯ ==========
            // При каждом изменении состояния кнопки обновляем дисплей
            // Это происходит при НАЖАТИИ и при ОТПУСКАНИИ
            updateDisplay();
        }
    }
    
    // ========== 7. СОХРАНЕНИЕ ТЕКУЩЕГО СОСТОЯНИЯ ==========
    // Запоминаем текущее состояние как предыдущее для следующего цикла
    lastButtonState = currentReading;
    
    // ========== 8. НЕБОЛЬШАЯ ЗАДЕРЖКА ==========
    // Задержка 10 миллисекунд:
    //   - Снижает нагрузку на процессор
    //   - Уменьшает потребление энергии
    //   - Не влияет на время реакции (10 мс незаметны для человека)
    delay(10);
}

// ============================================================================
// ПОЛЕЗНЫЕ ЗАМЕЧАНИЯ ПО РАБОТЕ С КНОПКАМИ
// ============================================================================

/*
 * ПОЧЕМУ НУЖЕН АНТИДРЕБЕЗГ?
 * 
 * Механическая кнопка при нажатии не переключается мгновенно и идеально.
 * В течение нескольких миллисекунд контакты "дребезжат" - многократно
 * замыкаются и размыкаются. Без антидребезга программа увидит это как
 * несколько нажатий вместо одного.
 * 
 * ЧТО ТАКОЕ ВНУТРЕННЯЯ ПОДТЯЖКА (INPUT_PULLUP)?
 * 
 * У ESP32 внутри микросхемы есть резисторы, которые можно подключить к пину.
 * Если пин настроен как INPUT_PULLUP, он подтянут к 3.3V через резистор ~50 кОм.
 * Это избавляет от необходимости добавлять внешний резистор.
 * 
 * ПОЧЕМУ ПРИ НАЖАТИИ МЫ ПОЛУЧАЕМ LOW, А НЕ HIGH?
 * 
 * Это называется "активный уровень LOW". Кнопка замыкает пин на GND (0V).
 * Так сделано исторически, потому что:
 * 1. LOW уровень более устойчив к помехам
 * 2. Внутренняя подтяжка к 3.3V проще реализована аппаратно
 * 3. Большинство микроконтроллеров так устроены
 * 
 * ЧТО ДЕЛАТЬ, ЕСЛИ НУЖНА КНОПКА С АКТИВНЫМ УРОВНЕМ HIGH?
 * 
 * Нужно подключить кнопку между пином и 3.3V, а пин настроить как INPUT_PULLDOWN.
 * Но не все ESP32 пины поддерживают PULLDOWN, поэтому чаще используют LOW.
 * 
 * ============================================================================
 * КОНФИГУРАЦИЯ platformio.ini ДЛЯ ЭТОГО ПРОЕКТА
 * ============================================================================
 * 
 * [env:freenove_esp32_s3_wroom]
 * platform = espressif32
 * board = freenove_esp32_s3_wroom
 * framework = arduino
 * 
 * ; НАСТРОЙКИ ПАМЯТИ (16MB Flash + 8MB PSRAM)
 * board_build.flash_size = 16MB
 * board_build.psram = enabled
 * board_build.psram_mode = octal
 * board_build.arduino.memory_type = qio_opi
 * board_build.f_cpu = 240000000L
 * 
 * ; НАСТРОЙКИ ПОРТА
 * monitor_speed = 115200
 * upload_speed = 921600
 * monitor_filters = esp32_exception_decoder
 * 
 * ; БИБЛИОТЕКИ (не забудьте установить!)
 * lib_deps = 
 *     adafruit/Adafruit GFX Library@^1.12.6
 *     adafruit/Adafruit SSD1306@^2.5.16
 * 
 * ============================================================================
 */